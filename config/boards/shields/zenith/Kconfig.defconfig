## config/boards/shields/zenith/Kconfig.defconfig
```kconfig
if SHIELD_ZENITH_DONGLE

config ZMK_KEYBOARD_NAME
    default "Zenith"

config ZMK_SPLIT_ROLE_CENTRAL
    default y

endif

if SHIELD_ZENITH_LEFT || SHIELD_ZENITH_RIGHT

config ZMK_SPLIT_ROLE_CENTRAL
    default n

endif

if SHIELD_ZENITH_LEFT || SHIELD_ZENITH_RIGHT || SHIELD_ZENITH_DONGLE

config ZMK_SPLIT
    default y

endif
```

## config/boards/shields/zenith/Kconfig.shield
```kconfig
config SHIELD_ZENITH_LEFT
    def_bool $(shields_list_contains,zenith_left)

config SHIELD_ZENITH_RIGHT
    def_bool $(shields_list_contains,zenith_right)
```

## config/west.yml
```yaml
manifest:
  remotes:
    - name: zmkfirmware
      url-base: https://github.com/zmkfirmware
  projects:
    - name: zmk
      remote: zmkfirmware
      revision: 9d714c0b69fee2098a010d29e534051aeca26386
      import: app/west.yml
  self:
    path: config
```
